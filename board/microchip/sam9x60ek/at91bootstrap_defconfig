## board/microchip/sam9x60ek/at91bootstrap_defconfig
```kconfig
CONFIG_SAM9X60EK=y
CONFIG_RAM_256MB=y
CONFIG_SDCARD=y
CONFIG_LOAD_LINUX=y
CONFIG_OVERRIDE_CMDLINE=y
CONFIG_LINUX_KERNEL_ARG_STRING="console=ttyS0,115200 root=/dev/mmcblk0p2 rw rootwait rootfstype=ext4 atmel.pm_modes=standby,ulp0 video=Unknown-1:800x480-16 quiet"
CONFIG_IMAGE_NAME="zImage"
CONFIG_THUMB=y
# CONFIG_HW_DISPLAY_BANNER is not set
CONFIG_SCLK_INTRC=y
# CONFIG_AUTOTWI_BUS is not set
```

## configs/sam9x60ek_graphics_defconfig
```kconfig
BR2_arm=y
BR2_CCACHE=y
BR2_CCACHE_DIR="$(BASE_DIR)/../buildroot-ccache"
BR2_OPTIMIZE_FAST=y
BR2_GLOBAL_PATCH_DIR="$(BR2_EXTERNAL_MCHP_PATH)/patches"
BR2_TOOLCHAIN_BUILDROOT_GLIBC=y
BR2_TOOLCHAIN_BUILDROOT_CXX=y
BR2_TARGET_GENERIC_HOSTNAME="sam9x60ek"
BR2_TARGET_GENERIC_ISSUE="Welcome to the Microchip Demo"
BR2_ROOTFS_DEVICE_CREATION_DYNAMIC_EUDEV=y
# BR2_TARGET_GENERIC_GETTY is not set
# BR2_ENABLE_LOCALE_PURGE is not set
BR2_GENERATE_LOCALE="en_US es_MX zh_CN"
BR2_SYSTEM_ENABLE_NLS=y
BR2_ROOTFS_OVERLAY="$(BR2_EXTERNAL_MCHP_PATH)/board/microchip/sama5/fs-overlay/ $(BR2_EXTERNAL_MCHP_PATH)/board/microchip/sam9x60ek/fs-overlay"
BR2_ROOTFS_POST_IMAGE_SCRIPT="support/scripts/genimage.sh"
BR2_ROOTFS_POST_SCRIPT_ARGS="-c $(BR2_EXTERNAL_MCHP_PATH)/board/microchip/sam9x60ek/genimage.cfg"
BR2_LINUX_KERNEL=y
BR2_LINUX_KERNEL_CUSTOM_GIT=y
BR2_LINUX_KERNEL_CUSTOM_REPO_URL="https://github.com/linux4sam/linux-at91.git"
BR2_LINUX_KERNEL_CUSTOM_REPO_VERSION="linux4sam-2020.10"
BR2_LINUX_KERNEL_USE_CUSTOM_CONFIG=y
BR2_LINUX_KERNEL_CUSTOM_CONFIG_FILE="$(BR2_EXTERNAL_MCHP_PATH)/board/microchip/sam9x60ek/linux.config"
BR2_LINUX_KERNEL_DTS_SUPPORT=y
BR2_LINUX_KERNEL_CUSTOM_DTS_PATH="$(BR2_EXTERNAL_MCHP_PATH)/board/microchip/sam9x60ek/at91-sam9x60ek.dts"
BR2_PACKAGE_BUSYBOX_SHOW_OTHERS=y
# BR2_PACKAGE_EUDEV_ENABLE_HWDB is not set
BR2_PACKAGE_I2C_TOOLS=y
BR2_PACKAGE_CAIRO_SVG=y
BR2_PACKAGE_LIBRSVG=y
# BR2_PACKAGE_IFUPDOWN_SCRIPTS is not set
BR2_TARGET_ROOTFS_EXT2=y
BR2_TARGET_ROOTFS_EXT2_4=y
BR2_TARGET_ROOTFS_EXT2_LABEL="ROOTFS"
BR2_TARGET_ROOTFS_EXT2_SIZE="128M"
BR2_TARGET_ROOTFS_EXT2_MKFS_OPTIONS="-O 64bit"
BR2_TARGET_AT91BOOTSTRAP3=y
BR2_TARGET_AT91BOOTSTRAP3_CUSTOM_GIT=y
BR2_TARGET_AT91BOOTSTRAP3_CUSTOM_REPO_URL="https://github.com/linux4sam/at91bootstrap.git"
BR2_TARGET_AT91BOOTSTRAP3_CUSTOM_REPO_VERSION="v3.10.2"
BR2_TARGET_AT91BOOTSTRAP3_USE_CUSTOM_CONFIG=y
BR2_TARGET_AT91BOOTSTRAP3_CUSTOM_CONFIG_FILE="$(BR2_EXTERNAL_MCHP_PATH)/board/microchip/sam9x60ek/at91bootstrap_defconfig"
BR2_PACKAGE_HOST_GENIMAGE=y
BR2_PACKAGE_LIBM2D=y
BR2_PACKAGE_LIBPLANES=y
# BR2_PACKAGE_LIBPLANES_INSTALL_EXAMPLES is not set
BR2_PACKAGE_EGT=y
# BR2_PACKAGE_EGT_MEDIA_SUPPORT is not set
# BR2_PACKAGE_EGT_CHART_SUPPORT is not set
BR2_PACKAGE_NOTO_FONTS=y
```
